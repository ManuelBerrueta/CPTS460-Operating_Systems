/****************
qemu with -kernel file.bin ==> start to execute from 0x10000 ==>
file.bin must be loaded to 0x10000 ==> . = 0x10000
************/

ENTRY(start)
SECTIONS
{
   . = 0x10000;
   .start . : { ts.o(.text) }
   .text : { *(.text) }
   .data : { *(.data) }
   .bss : { *(.bss COMMON) }

   . = ALIGN(8);
   . = . + 0x10000; /* 0x1000 for 4KB; x10000=64kB of stack memory */
   stack_top = .;
}

/* QUESTION: show the memory map of the image file generated by the linker */
/*
Symbol table '.symtab' contains 71 entries:
   Num:    Value  Size Type    Bind   Vis      Ndx Name
     0: 00000000     0 NOTYPE  LOCAL  DEFAULT  UND 
     1: 00010000     0 SECTION LOCAL  DEFAULT    1 
     2: 00010010     0 SECTION LOCAL  DEFAULT    2 
     3: 00010c30     0 SECTION LOCAL  DEFAULT    3 
     4: 00010cbc     0 SECTION LOCAL  DEFAULT    4 
     5: 00010cf4     0 SECTION LOCAL  DEFAULT    5 
     6: 00000000     0 SECTION LOCAL  DEFAULT    6 
     7: 00000000     0 SECTION LOCAL  DEFAULT    7 
     8: 00000000     0 SECTION LOCAL  DEFAULT    8 
     9: 00000000     0 SECTION LOCAL  DEFAULT    9 
    10: 00000000     0 SECTION LOCAL  DEFAULT   10 
    11: 00000000     0 SECTION LOCAL  DEFAULT   11 
    12: 00000000     0 SECTION LOCAL  DEFAULT   12 
    13: 00000000     0 SECTION LOCAL  DEFAULT   13 
    14: 00000000     0 FILE    LOCAL  DEFAULT  ABS ts.o
    15: 00010000     0 NOTYPE  LOCAL  DEFAULT    1 $a
    16: 0001000c     0 NOTYPE  LOCAL  DEFAULT    1 $d
    17: 00000000     0 FILE    LOCAL  DEFAULT  ABS t.c
    18: 00010cbc     0 NOTYPE  LOCAL  DEFAULT    4 $d
    19: 00010c30     0 NOTYPE  LOCAL  DEFAULT    3 $d
    20: 00010010     0 NOTYPE  LOCAL  DEFAULT    2 $a
    21: 0001009c     0 NOTYPE  LOCAL  DEFAULT    2 $d
    22: 000100a8     0 NOTYPE  LOCAL  DEFAULT    2 $a
    23: 000102b8     0 NOTYPE  LOCAL  DEFAULT    2 $d
    24: 000102c0     0 NOTYPE  LOCAL  DEFAULT    2 $a
    25: 0001040c     0 NOTYPE  LOCAL  DEFAULT    2 $d
    26: 00010414     0 NOTYPE  LOCAL  DEFAULT    2 $a
    27: 00010504     0 NOTYPE  LOCAL  DEFAULT    2 $d
    28: 0001050c     0 NOTYPE  LOCAL  DEFAULT    2 $a
    29: 00010640     0 NOTYPE  LOCAL  DEFAULT    2 $d
    30: 00010698     0 NOTYPE  LOCAL  DEFAULT    2 $a
    31: 00010ae8     0 NOTYPE  LOCAL  DEFAULT    2 $d
    32: 00000010     0 NOTYPE  LOCAL  DEFAULT   13 $d
    33: 00000000     0 FILE    LOCAL  DEFAULT  ABS _udivsi3.o
    34: 00010b18     0 NOTYPE  LOCAL  DEFAULT    2 $a
    35: 00010b18     0 NOTYPE  LOCAL  DEFAULT    2 .udivsi3_skip_div0_test
    36: 00000248     0 NOTYPE  LOCAL  DEFAULT   13 $d
    37: 00000000     0 FILE    LOCAL  DEFAULT  ABS _dvmd_tls.o
    38: 00010c2c     0 NOTYPE  LOCAL  DEFAULT    2 $a
    39: 00010cf4     4 OBJECT  GLOBAL DEFAULT    5 N
    40: 0001050c    88 FUNC    GLOBAL DEFAULT    2 printo
    41: 00010cf0     4 OBJECT  GLOBAL DEFAULT    4 BASE_OCT
    42: 00010cf8     4 OBJECT  GLOBAL DEFAULT    5 up
    43: 000101cc    84 FUNC    GLOBAL DEFAULT    2 uprints
    44: 000100f4    92 FUNC    GLOBAL DEFAULT    2 uputc
    45: 00010b18   244 FUNC    GLOBAL HIDDEN     2 __udivsi3
    46: 00010cfc     4 OBJECT  GLOBAL DEFAULT    5 sum
    47: 000100a8    76 FUNC    GLOBAL DEFAULT    2 ugetc
    48: 00010150   124 FUNC    GLOBAL DEFAULT    2 ugets
    49: 0001086c   168 FUNC    GLOBAL DEFAULT    2 mystrcmp
    50: 00010ce4     4 OBJECT  GLOBAL DEFAULT    4 tab
    51: 00010ce8     4 OBJECT  GLOBAL DEFAULT    4 BASE
    52: 00010010   152 FUNC    GLOBAL DEFAULT    2 uart_init
    53: 00010564   692 FUNC    GLOBAL DEFAULT    2 ufprintf
    54: 00010cbc    40 OBJECT  GLOBAL DEFAULT    4 v
    55: 00020d20     0 NOTYPE  GLOBAL DEFAULT    5 stack_top
    56: 00010c2c     4 FUNC    WEAK   HIDDEN     2 __aeabi_ldiv0
    57: 00010220   160 FUNC    GLOBAL DEFAULT    2 rpu
    58: 00010914   516 FUNC    GLOBAL DEFAULT    2 main
    59: 00010b18     0 FUNC    GLOBAL HIDDEN     2 __aeabi_uidiv
    60: 0001046c   160 FUNC    GLOBAL DEFAULT    2 oct
    61: 00010318    92 FUNC    GLOBAL DEFAULT    2 printd
    62: 00010c0c    32 FUNC    GLOBAL HIDDEN     2 __aeabi_uidivmod
    63: 000102c0    88 FUNC    GLOBAL DEFAULT    2 printu
    64: 00010374   160 FUNC    GLOBAL DEFAULT    2 hex
    65: 00010cec     4 OBJECT  GLOBAL DEFAULT    4 BASE_HEX
    66: 00010414    88 FUNC    GLOBAL DEFAULT    2 printx
    67: 00010d00    32 OBJECT  GLOBAL DEFAULT    5 uart
    68: 00010000     0 NOTYPE  GLOBAL DEFAULT    1 start
    69: 00010c2c     4 FUNC    WEAK   HIDDEN     2 __aeabi_idiv0
    70: 00010818    84 FUNC    GLOBAL DEFAULT    2 mystrlen
*/
